## board/src/mainboard/asrock/h61m-s1-plus/Kconfig
```kconfig
## SPDX-License-Identifier: GPL-2.0-only

if BOARD_ASROCK_H61M_S1_PLUS

config BOARD_SPECIFIC_OPTIONS
	def_bool y
	select BOARD_ROMSIZE_KB_8192
	select DEFAULT_POST_ON_LPC
	select DRIVERS_OPTION_CFR_ENABLED if PAYLOAD_EDK2 && SMMSTORE
	select HAVE_ACPI_RESUME
	select HAVE_ACPI_TABLES
	select HAVE_CMOS_DEFAULT
	select HAVE_OPTION_TABLE
	select HAVE_POWER_STATE_AFTER_FAILURE
	select HAVE_POWER_STATE_PREVIOUS_AFTER_FAILURE
	select INTEL_GMA_HAVE_VBT
	select INTEL_INT15
	select MAINBOARD_HAS_LIBGFXINIT
	select MAINBOARD_HAS_TPM1
	select MEMORY_MAPPED_TPM
	select NORTHBRIDGE_INTEL_SANDYBRIDGE
	select SERIRQ_CONTINUOUS_MODE
	select SOUTHBRIDGE_INTEL_BD82X6X
	select SUPERIO_NUVOTON_NCT6776
	select SUPERIO_NUVOTON_COMMON_COM_A
	select SUPERIO_NUVOTON_COMMON_HWM
	select USE_NATIVE_RAMINIT

config MAINBOARD_DIR
	default "asrock/h61m-s1-plus"

config MAINBOARD_PART_NUMBER
	default "H61M-S1 PLUS"

config MAINBOARD_VERSION
	default "1.0"

config CBFS_SIZE
	default 0x680000

config SMMSTORE_SIZE
	default 0x40000

config SUPERIO_NUVOTON_PNP_BASE
	default 0x2e

endif
```

## board/src/mainboard/asrock/h61m-s1-plus/Kconfig.name
```kconfig
## SPDX-License-Identifier: GPL-2.0-only

config BOARD_ASROCK_H61M_S1_PLUS
	bool "H61M-S1 PLUS"
```

## configs/h61m-s1-plus-w25q32-4mb-stock-me.defconfig
```kconfig
CONFIG_NO_STAGE_CACHE=y
CONFIG_VENDOR_ASROCK=y
CONFIG_ONBOARD_VGA_IS_PRIMARY=y
CONFIG_PCIEXP_CLK_PM=y
CONFIG_BOARD_ASROCK_H61M_S1_PLUS=y
CONFIG_COREBOOT_ROMSIZE_KB_4096=y
CONFIG_CBFS_SIZE=0x280000
CONFIG_CONSOLE_POST=y
CONFIG_HIDE_MEI_ON_ERROR=y
CONFIG_INTEL_GMA_ADD_VBT=y
CONFIG_PCIEXP_DEFAULT_MAX_RESIZABLE_BAR_BITS=34
CONFIG_EDK2_BOOT_TIMEOUT=5
CONFIG_EDK2_BOOT_MANAGER_ESCAPE=y
CONFIG_EDK2_BOOTSPLASH_FILE=""
CONFIG_ALWAYS_ALLOW_ABOVE_4G_ALLOCATION=y
CONFIG_NATIVE_RAMINIT_IGNORE_XMP_REQUESTED_VOLTAGE=y
CONFIG_PCIEXP_SUPPORT_RESIZABLE_BARS=y
CONFIG_PCIEXP_LANE_ERR_STAT_CLEAR=y
CONFIG_SUBSYSTEM_VENDOR_ID=0x1849
CONFIG_DEFAULT_CONSOLE_LOGLEVEL_8=y
CONFIG_TPM1=y
CONFIG_PAYLOAD_EDK2=y
CONFIG_EDK2_TAG_OR_REV="f248a68be339831b69a880d9c932a6a3cf3c461a"
CONFIG_EDK2_LOAD_OPTION_ROMS=y
CONFIG_EDK2_SERIAL_SUPPORT=y
CONFIG_EDK2_CUSTOM_BUILD_PARAMS="-D BOOTSPLASH_IMAGE=FALSE"
CONFIG_COMPRESSED_PAYLOAD_LZMA=y
```
